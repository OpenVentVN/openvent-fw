## main/Kconfig.projbuild
```kconfig
menu "OpenVent Configuration"

config USE_SEC_1
        bool
        default y
        prompt "Use Security Version 1"
        help
            Security version 1 used Curve25519 key exchange for establishing
            secure session between device and client during provisioning

config SECURITY_POP
    string "Proof-of-possession"
    default "1234abcd"
    help
	   Proof-of-possession can be optionally used to prove that the device is indeed in possession of the user who is provisioning the device. This proof-of-possession is internally used to generate the shared secret through key exchange.

endmenu
```

## sdkconfig.defaults
```kconfig
# Serial flash

CONFIG_BT_ENABLED=y
CONFIG_BTDM_CTRL_MODE_BLE_ONLY=y
CONFIG_BTDM_CTRL_MODE_BR_EDR_ONLY=n
CONFIG_BTDM_CTRL_MODE_BTDM=n

CONFIG_ESPTOOLPY_COMPRESSED=y
CONFIG_ESPTOOLPY_FLASHSIZE_4MB=y

CONFIG_PARTITION_TABLE_CUSTOM=y
CONFIG_PARTITION_TABLE_CUSTOM_FILENAME="partitions.csv"
CONFIG_FREERTOS_HZ=1000

CONFIG_ESP32_DEFAULT_CPU_FREQ_240=y
CONFIG_ESP32_DEFAULT_CPU_FREQ_MHZ=240
```
